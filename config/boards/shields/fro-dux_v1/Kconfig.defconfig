## config/boards/shields/fro-dux_v1/Kconfig.defconfig
```kconfig
if SHIELD_FRO_DUX_V1_LEFT

# Name must be less than 16 characters long!
config ZMK_KEYBOARD_NAME
    default "fro-dux v1"

config ZMK_SPLIT_ROLE_CENTRAL
    default y

endif

if SHIELD_FRO_DUX_V1_LEFT || SHIELD_FRO_DUX_V1_RIGHT

config ZMK_SPLIT
    default y

endif
```

## config/boards/shields/fro-dux_v1/Kconfig.shield
```kconfig
config SHIELD_FRO_DUX_V1_LEFT
	def_bool $(shields_list_contains,fro-dux_v1_left)

config SHIELD_FRO_DUX_V1_RIGHT
	def_bool $(shields_list_contains,fro-dux_v1_right)
```

## config/west.yml
```yaml
manifest:
  remotes:
    - name: zmkfirmware
      url-base: https://github.com/zmkfirmware
    - name: urob
      url-base: https://github.com/urob
  projects:
    - name: zmk-auto-layer
      remote: urob
      revision: main
      path: modules/auto-layer
    - name: zmk-helpers
      remote: urob
      revision: main
      path: modules/helpers
    - name: zmk
      remote: zmkfirmware
      revision: main
      import: app/west.yml
  self:
    path: config
```
